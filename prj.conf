## CMakeLists.txt
```
cmake_minimum_required(VERSION 3.20.0)

find_package(Zephyr REQUIRED HINTS $ENV{ZEPHYR_BASE})

project(lumppari_logger)

target_sources(app PRIVATE
    src/main.c
    src/sensors.c
)
```

## west.yml
```
manifest:
  projects:
    - name: zephyr
      url: https://github.com/zephyrproject-rtos/zephyr
      revision: v4.5.0
      import: true

  self:
    path: lumppari-logger
```

## prj.conf
```kconfig
CONFIG_PRINTK=y
CONFIG_TICKLESS_KERNEL=y
```

## src/main.c
```c
#include <zephyr/kernel.h>
#include <zephyr/sys/printk.h>

int main(void)
{
    printk("Lumppari Logger started!\n");

    while (1) {
        k_sleep(K_SECONDS(10));
        printk("Logger alive\n");
    }

    return 0;
}
```

## src/sensors.c
```c
#include <zephyr/kernel.h>
#include <zephyr/sys/printk.h>

#define SENSORS_STACK_SIZE 1024
#define SENSORS_PRIORITY   5

static void sensors_thread(void *p1, void *p2, void *p3)
{
    ARG_UNUSED(p1);
    ARG_UNUSED(p2);
    ARG_UNUSED(p3);

    printk("Sensors thread started\n");

    while (true) {
        // TODO: Read DS18B20 and other sensors

        printk("Sensors read:\n");
        k_sleep(K_SECONDS(10));
    }
}

K_THREAD_DEFINE(sensors_tid,
                SENSORS_STACK_SIZE,
                sensors_thread,
                NULL, NULL, NULL,
                SENSORS_PRIORITY,
                0,
                0);
```
